## meta-axell/conf/layer.conf
```bitbake
# We have a conf and classes directory, add to BBPATH
BBPATH .= ":${LAYERDIR}"

# We have recipes-* directories, add to BBFILES
BBFILES += "${LAYERDIR}/recipes-*/*/*.bb \
	${LAYERDIR}/recipes-*/*/*.bbappend"

BBFILE_COLLECTIONS += "axell"
BBFILE_PATTERN_axell = "^${LAYERDIR}/"
BBFILE_PRIORITY_axell = "15"

LAYERDEPENDS_axell = "amdfalconx86"
```

## meta-axell/conf/machine/include/amd-customer-configurations.inc
```bitbake
APPEND_ADDITIONAL ?= "quiet"
KERNEL_SERIAL_CONSOLE ?= "console=ttyS4,115200n8"
SERIAL_CONSOLES ?= "115200;ttyS4 115200;ttyS5"
```
